/*
 * lab8_5.c
 *
 * Created: 7/29/2026 8:53:41 AM
 *  Author: Evan Baesler
 */ 

#include <avr/io.h>

// PROTOTYPES

extern void clock_init(void);
void usartd0_init(void);
void daca_init(void);
void tcc0_init(void);
void tcc1_init(void);
void dmac_init(void);

char usartd0_in(void);
void set_note(float freq);
void set_wave(uint8_t mode);

uint16_t per; // Played Note Frequency 
uint8_t mode = 0; // 0 = sine, 1 = triangle

// Baud Rate (9600bps from previous labs)
uint8_t BSEL = 207;
uint8_t BSCALE = 0;

// 256 Value Sine Wave Approximation
uint16_t sine_table[256] =
{0x800, 0x832, 0x864, 0x896, 0x8c8, 0x8fa, 0x92c, 0x95e,
	0x98f, 0x9c0, 0x9f1, 0xa22, 0xa52, 0xa82, 0xab1, 0xae0,
	0xb0f, 0xb3d, 0xb6b, 0xb98, 0xbc5, 0xbf1, 0xc1c, 0xc47,
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	0x670, 0x6a1, 0x6d3, 0x705, 0x737, 0x769, 0x79b, 0x7cd};

// 256 Value Triangle Wave Approximation
uint16_t tri_table[256] =
{0x00, 0x20, 0x40, 0x60, 0x80, 0xa0, 0xc0, 0xe0, 0x100,
	0x120, 0x140, 0x160, 0x180, 0x1a0, 0x1c0, 0x1e0, 0x200,
	0x220, 0x240, 0x260, 0x280, 0x2a0, 0x2c0, 0x2e0, 0x300,
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0xe0, 0xc0, 0xa0, 0x80, 0x60, 0x40, 0x20};

// Point to a Table
uint16_t *waveform_ptr = sine_table;

int main(void)
{
	
	clock_init(); // Sets Clock to 32MHz
	
	usartd0_init(); // Initialize USART
	daca_init(); // Digital To Analog Converter
	tcc0_init(); // Audio Playback Timer
	tcc1_init(); // Audio Delay Timer
	dmac_init(); // Initialize table in memory
	
	// Enable audio amplifier (disable shutdown)
	PORTC.DIRSET = PIN7_bm;
	PORTC.OUTSET = PIN7_bm;

	while (1)
	{
		if(USARTD0.STATUS & USART_RXCIF_bm) // Wait for USART to be ready
		{
			char c = usartd0_in(); // Get input character
	
			if(c=='s' || c=='S') // Do both 's' or 'S' for caps insensitivity
			{
				mode ^= 1; // Flip between 0/1
				set_wave(mode); // Update mode
			}
			else if(c=='e' || c=='E')
			set_note(1046.50); // Play C6
			else if(c=='4')
			set_note(1108.73); // Play C#6 / Db6
			else if(c=='r' || c=='R')
			set_note(1174.66); // Play D6
			else if(c=='5')
			set_note(1244.51); // Play D#6 / Eb6
			else if(c=='t' || c=='T')
			set_note(1318.51); // Play E6
			else if(c=='y' || c=='Y')
			set_note(1396.91); // Play F6
			else if(c=='7')
			set_note(1479.98); // Play F#6 / Gb6
			else if(c=='u' || c=='U')
			set_note(1567.98); // Play G6
			else if(c=='8')
			set_note(1661.22); // Play G#6 / Ab6
			else if(c=='i' || c=='I')
			set_note(1760.00); // Play A6
			else if(c=='9')
			set_note(1864.66); // Play A#6 / Bb6
			else if(c=='o' || c=='O')
			set_note(1975.53); // Play B6
			else if(c=='p' || c=='P')
			set_note(2093.00); // Play C7
		}
		
		if(TCC1.INTFLAGS & TC1_OVFIF_bm) // Wait for delay to end
		{
			TCC1.INTFLAGS = TC1_OVFIF_bm; // Reset flag
			TCC0.CTRLA = TC_CLKSEL_OFF_gc; // Turn off audio playback timer
		}
	}
}

void daca_init(void)
{
	// Enable DAC Channel 1 for Speaker
	DACA.CTRLB = DAC_CHSEL_SINGLE1_gc; // Select DAC Channel 1 (PA3) (Speaker)
	
	// Use AREFB (2.5V) as the DAC reference
	DACA.CTRLC = DAC_REFSEL_AREFB_gc;

	DACA.CTRLA = DAC_ENABLE_bm | DAC_CH1EN_bm; // Enable CH1 DAC
}

void tcc0_init(void)
{
	// Audio Playback Timer
	TCC0.CNT = 0; // Reset TCC0 count
	TCC0.INTFLAGS = TC0_OVFIF_bm; // Reset TCC0 flags
	TCC0.CTRLA = TC_CLKSEL_OFF_gc; // Turn off playback
}

void tcc1_init(void)
{
	// Audio Delay Timer
    TCC1.CNT = 0;

    // 275ms delay (just enough to prevent skipping when holding key)
    TCC1.PER = (275e-3)*(32e6/256); // 256 PRE set in DMA
	TCC1.INTFLAGS = TC1_OVFIF_bm; // Reset flags
	
	TCC1.CTRLA = TC_CLKSEL_OFF_gc; // Turn off delay
}

void dmac_init(void)
{
	DMA.CTRL|= DMA_RESET_bm; // Reset DMA

	DMA.CH0.TRFCNT = 512; // 256 Data Entries * 2
	DMA.CH0.REPCNT = 0; // Infinite Repeats

	// Reload full block, increment source/output, reload in bursts
	DMA.CH0.ADDRCTRL =
	DMA_CH_SRCRELOAD_BLOCK_gc |
	DMA_CH_SRCDIR_INC_gc |
	DMA_CH_DESTDIR_INC_gc |
	DMA_CH_DESTRELOAD_BURST_gc;

	// Turn on repeat, CH0, and 2BYTE burst
	DMA.CH0.CTRLA =
	DMA_CH_REPEAT_bm |
	DMA_CH_SINGLE_bm |
	DMA_CH_BURSTLEN_2BYTE_gc;

	// Timer overflow -> Event Channel 0 -> DMA Update
	EVSYS.CH0MUX = EVSYS_CHMUX_TCC0_OVF_gc;
	DMA.CH0.TRIGSRC = DMA_CH_TRIGSRC_EVSYS_CH0_gc;

	// Source addressing thru pointers
	DMA.CH0.SRCADDR0= (uint8_t)((uintptr_t) sine_table);
	DMA.CH0.SRCADDR1= (uint8_t)(((uintptr_t) sine_table) >> 8);
	DMA.CH0.SRCADDR2= (uint8_t)(((uint32_t)((uintptr_t)sine_table)) >>16);
	
	// Destination Addressing
	DMA.CH0.DESTADDR0= (uint8_t)((uintptr_t) &DACA.CH1DATA);
	DMA.CH0.DESTADDR1= (uint8_t)(((uintptr_t) &DACA.CH1DATA) >> 8);
	DMA.CH0.DESTADDR2= (uint8_t)(((uint32_t)((uintptr_t)&DACA.CH1DATA)) >>16);

	DMA.CH0.CTRLA |= DMA_CH_ENABLE_bm;

	DMA.CTRL = DMA_ENABLE_bm;
}

void usartd0_init(void)
{
	// TX (PD3) output
	PORTD.OUTSET = PIN3_bm;
	PORTD.DIRSET = PIN3_bm;

	// RX (PD2) input
	PORTD.DIRCLR = PIN2_bm;

	// 9600 baud @ 32 MHz
	USARTD0.BAUDCTRLA = BSEL;
	USARTD0.BAUDCTRLB = BSCALE;

	// 8 data bits, no parity, 1 stop bit
	USARTD0.CTRLC = USART_CHSIZE_8BIT_gc;

	// Enable transmitter / receiver
	USARTD0.CTRLB = USART_TXEN_bm | USART_RXEN_bm;
}

char usartd0_in(void)
{
	while (!(USARTD0.STATUS & USART_RXCIF_bm)); // Wait for USART

	return USARTD0.DATA; // Sends back char from USARTD0 input
}

void set_note(float freq)
{
	per = (32000000.0 / (256.0 * freq)) - 1; // PER = SCF/(PRE*FREQ) - 1

	TCC0.PER = per; // Update frequency
	TCC0.CNT = 0; // Reset count
	TCC0.CTRLA = TC_CLKSEL_DIV1_gc; // Start audio playback timer

	TCC1.CNT = 0;
	TCC1.INTFLAGS = TC1_OVFIF_bm;
	TCC1.CTRLA = TC_CLKSEL_DIV256_gc; // Start 275ms delay timer
}

void set_wave(uint8_t mode)
{
	// Temporarily disable DMA channel during config
	DMA.CH0.CTRLA &= ~DMA_CH_ENABLE_bm;

	if(mode == 0) // Mode 0 = Sine
	{
		waveform_ptr = sine_table;
	}
	else // Mode 1 = Tri
	{
		waveform_ptr = tri_table;
	}

	// Update source address
	DMA.CH0.SRCADDR0 = (uint8_t)((uintptr_t)waveform_ptr);
	DMA.CH0.SRCADDR1 = (uint8_t)(((uintptr_t)waveform_ptr) >> 8);
	DMA.CH0.SRCADDR2 = (uint8_t)(((uint32_t)((uintptr_t)waveform_ptr)) >> 16);

	// Reset transfer count
	DMA.CH0.TRFCNT = 512;

	// Re-enable DMA CH0
	DMA.CH0.CTRLA |= DMA_CH_ENABLE_bm;
}

void note_timer(void)
{
	TCC1.CNT = 0; // Reset timer

	TCC1.INTFLAGS = TC1_OVFIF_bm; // Reset flags

	TCC1.CTRLA = TC_CLKSEL_DIV256_gc; // Enable 275ms timer
}